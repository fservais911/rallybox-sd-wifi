## main/Kconfig.projbuild
```kconfig
menu "RallyBox"

    menu "SD Card Settings"

        config RALLYBOX_SD1_CONTROL_GPIO
            int "SD Card 1 control GPIO"
            range 0 54
            default 45
            help
                GPIO used to control SD Card 1 mount and unmount state.

        config RALLYBOX_SD2_CONTROL_GPIO
            int "SD Card 2 control GPIO"
            range 0 54
            default 29
            help
                GPIO used to control SD Card 2 mount and unmount state.

    endmenu

    menu "WiFi Settings"

        config RALLYBOX_WIFI_MAXIMUM_RETRY
            int "Maximum WiFi retries"
            range 1 20
            default 5
            help
                Number of station reconnect attempts before reporting failure.

    endmenu

    menu "RaceBox Settings"

        config RALLYBOX_RACEBOX_ENABLED
            bool "Enable RaceBox BLE"
            default y
            select BT_ENABLED
            select BT_CONTROLLER_DISABLED
            select BT_BLUEDROID_ENABLED
            select ESP_HOSTED_ENABLE_BT_BLUEDROID
            select ESP_HOSTED_BLUEDROID_HCI_VHCI
            help
                Enables the RaceBox BLE client module and the hosted Bluedroid path.

        config RALLYBOX_RACEBOX_TARGET_NAME
            string "Primary RaceBox device name match"
            default "RaceBox"
            depends on RALLYBOX_RACEBOX_ENABLED
            help
                Primary case-sensitive substring used to identify RaceBox devices.

        config RALLYBOX_RACEBOX_ALT_TARGET_NAME
            string "Alternate RaceBox device name match"
            default "Racebox"
            depends on RALLYBOX_RACEBOX_ENABLED
            help
                Alternate case-sensitive substring used to identify RaceBox devices.

        config RALLYBOX_RACEBOX_SCAN_INTERVAL
            hex "BLE scan interval"
            range 0x0004 0x4000
            default 0x50
            depends on RALLYBOX_RACEBOX_ENABLED
            help
                BLE scan interval passed to esp_ble_gap_set_scan_params().

        config RALLYBOX_RACEBOX_SCAN_WINDOW
            hex "BLE scan window"
            range 0x0004 0x4000
            default 0x30
            depends on RALLYBOX_RACEBOX_ENABLED
            help
                BLE scan window passed to esp_ble_gap_set_scan_params().

        config RALLYBOX_RACEBOX_SCAN_DURATION_SECONDS
            int "BLE scan duration (seconds)"
            range 1 60
            default 10
            depends on RALLYBOX_RACEBOX_ENABLED
            help
                Duration for each BLE scan round before restarting or connecting.

    endmenu

    menu "GNSS Settings"

        config RALLYBOX_GNSS_ENABLED
            bool "Enable GNSS UART"
            default y
            help
                Enables the GNSS UART reader and NMEA parser task.

        config RALLYBOX_GNSS_UART_PORT
            int "GNSS UART port"
            range 0 2
            default 1
            depends on RALLYBOX_GNSS_ENABLED
            help
                UART controller index used for the external GNSS receiver.

        config RALLYBOX_GNSS_UART_BAUD_RATE
            int "GNSS UART baud rate"
            range 9600 921600
            default 115200
            depends on RALLYBOX_GNSS_ENABLED
            help
                Baud rate used to receive NMEA sentences from the GNSS module.

        config RALLYBOX_GNSS_UART_RX_GPIO
            int "GNSS UART RX GPIO"
            range 0 54
            default 10
            depends on RALLYBOX_GNSS_ENABLED
            help
                GPIO connected to the GNSS module TX output.

        config RALLYBOX_GNSS_UART_TX_GPIO
            int "GNSS UART TX GPIO"
            range 0 54
            default 11
            depends on RALLYBOX_GNSS_ENABLED
            help
                GPIO connected to the GNSS module RX input if outbound commands are used.

    endmenu

    menu "Track Logging / GPX"

        config RALLYBOX_STREAM_BUFFER_BYTES
            int "UART stream buffer size per feed (bytes)"
            range 4096 1048576
            default 131072
            help
                Size of each GNSS/BLE ring buffer. The code attempts PSRAM allocation first,
                then falls back to internal RAM.

        comment "Track point capacity is derived automatically from available PSRAM at runtime."

        config RALLYBOX_TRACK_MIN_POINT_INTERVAL_MS
            int "Minimum interval between stored points (ms)"
            range 40 5000
            default 200
            help
                Limits how frequently points are stored. 200 ms equals up to 5 Hz.

        config RALLYBOX_GPX_WEB_UPLOAD_URL
            string "GPX web upload URL or URL template"
            default ""
            help
                Optional upload target for WEB button.
                Precedence: if this field is non-empty, it is used first.
                S3 bucket/region/prefix settings are only used when this field is empty.
                If the URL contains {filename}, it will be replaced.
                If the URL ends with '/', filename will be appended.
                If this is set to an S3 endpoint root (for example https://s3.region.amazonaws.com),
                firmware will auto-append /bucket/prefix/filename when S3 bucket is configured.
                Use a pre-signed S3 URL for easiest integration.

        config RALLYBOX_GPX_WEB_AUTH_HEADER
            string "Optional web auth header name"
            default ""
            help
                Optional header name for upload auth (for example Authorization).

        config RALLYBOX_GPX_WEB_AUTH_VALUE
            string "Optional web auth header value"
            default ""
            help
                Optional header value paired with the auth header name.

        config RALLYBOX_GPX_WEB_SIGNER_URL
            string "Optional GPX signer URL or URL template"
            default ""
            help
                Optional trusted backend endpoint used to fetch one fresh presigned
                upload URL per filename.
                If set, this takes precedence over the static GPX web upload URL.
                If the URL contains {filename}, it will be replaced with the final
                generated filename.
                If the URL ends with '/', filename will be appended.
                The signer response may be plain text containing the full upload URL,
                or JSON containing "upload_url" or "url".

        config RALLYBOX_GPX_WEB_SIGNER_AUTH_HEADER
            string "Optional GPX signer auth header name"
            default ""
            help
                Optional header name for the signer request.

        config RALLYBOX_GPX_WEB_SIGNER_AUTH_VALUE
            string "Optional GPX signer auth header value"
            default ""
            help
                Optional header value paired with the signer auth header name.

        config RALLYBOX_GPX_S3_BUCKET
            string "S3 bucket name (optional)"
            default ""
            help
                Used to build upload URL only when GPX web upload URL is empty.
                Also used as fallback when GPX web upload URL is an endpoint root URL.

        config RALLYBOX_GPX_S3_REGION
            string "S3 region"
            default "us-east-1"
            help
                Region used to build S3 endpoint URL.

        config RALLYBOX_GPX_S3_OBJECT_PREFIX
            string "S3 object key prefix"
            default "tracks/"
            help
                Optional object prefix inside the bucket.

        config RALLYBOX_GPX_S3_ACCESS_KEY_ID
            string "Optional S3 access key ID"
            default ""
            help
                Deprecated for GPX upload.
                GPX WEB upload now expects a pre-signed URL or pre-signed query string
                generated outside the device.

        config RALLYBOX_GPX_S3_SECRET_ACCESS_KEY
            string "Optional S3 secret access key"
            default ""
            help
                Deprecated for GPX upload.
                GPX WEB upload now expects a pre-signed URL or pre-signed query string
                generated outside the device.

        config RALLYBOX_GPX_S3_SESSION_TOKEN
            string "Optional S3 session token"
            default ""
            help
                Deprecated for GPX upload.
                GPX WEB upload now expects a pre-signed URL or pre-signed query string
                generated outside the device.

        config RALLYBOX_GPX_S3_PRESIGNED_QUERY
            string "Optional S3 presigned query string"
            default ""
            help
                Optional query appended to generated S3 URL for pre-signed uploads.
                Example: X-Amz-Algorithm=...&X-Amz-Signature=...

        config RALLYBOX_GPX_S3_VIRTUAL_HOSTED_STYLE
            bool "Use virtual-hosted S3 URL style"
            default y
            help
                Enabled: https://bucket.s3.region.amazonaws.com/key
                Disabled: https://s3.region.amazonaws.com/bucket/key

        config RALLYBOX_GPX_S3_USE_HTTPS
            bool "Use HTTPS for generated S3 URL"
            default y

    endmenu

    menu "Firmware OTA"

        config RALLYBOX_OTA_S3_BUCKET
            string "OTA S3 bucket override"
            default ""
            help
                Optional dedicated OTA bucket. When left empty, the GPX S3 bucket is used.

        config RALLYBOX_OTA_S3_REGION
            string "OTA S3 region override"
            default ""
            help
                Optional dedicated OTA region. When left empty, the GPX S3 region is used.

        config RALLYBOX_OTA_S3_OBJECT_PREFIX
            string "OTA object prefix"
            default "firmware/RallyBox-Dashboard/"
            help
                Folder/key prefix inside the OTA bucket.

        config RALLYBOX_OTA_FILENAME
            string "OTA firmware filename"
            default "RallyBox-Dashboard.bin"
            help
                Public firmware object downloaded by the in-device OTA updater.

    endmenu

endmenu
```
